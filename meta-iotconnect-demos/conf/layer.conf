## meta-iotconnect-demos/conf/layer.conf
```bitbake
# We have a conf and classes directory, add to BBPATH
BBPATH .= ":${LAYERDIR}"

# We have recipes-* directories, add to BBFILES
BBFILES += "${LAYERDIR}/recipes-*/*/*.bb \
            ${LAYERDIR}/recipes-*/*/*.bbappend \
            ${LAYERDIR}/images/*.bb"

BBFILE_COLLECTIONS += "meta-iotconnect-demos"
BBFILE_PATTERN_meta-iotconnect-demos = "^${LAYERDIR}/"
BBFILE_PRIORITY_meta-iotconnect-demos = "6"

LAYERDEPENDS_meta-iotconnect-demos = "core"
LAYERSERIES_COMPAT_meta-iotconnect-demos = "hardknott"
```
